## main/Kconfig.projbuild
```kconfig
menu "Example Configuration"
  
     config BUTTON_PERIOD_TIME_MS
        int "BUTTON PERIOD TIME (MS)"
        range 2 20
        default 5
        help
            "Button scan interval"

    config BUTTON_DEBOUNCE_TICKS
        int "BUTTON DEBOUNCE TICKS"
        range 1 8
        default 6

    config BUTTON_SHORT_PRESS_TIME_MS
        int "BUTTON SHORT PRESS TIME (MS)"
        range 50 800
        default 180

    config BUTTON_LONG_PRESS_TIME_MS
        int "BUTTON LONG PRESS TIME (MS)"
        range 500 5000
        default 2500

    config ADC_BUTTON_MAX_CHANNEL
        int "ADC BUTTON MAX CHANNEL"
        range 1 5
        default 3
        help
            "Maximum number of channels for ADC buttons"

    config ADC_BUTTON_MAX_BUTTON_PER_CHANNEL
        int "ADC BUTTON MAX BUTTON PER CHANNEL"
        range 1 10
        default 8
        help
            "Maximum number of buttons per channel"

    config ADC_BUTTON_SAMPLE_TIMES
        int "ADC BUTTON SAMPLE TIMES"
        range 1 4
        default 1
        help
            "Number of samples per scan"   
    config EXAMPLE_FIRMWARE_UPGRADE_URL_FROM_STDIN
        bool
        default y if EXAMPLE_FIRMWARE_UPG_URL = "FROM_STDIN"

    config EXAMPLE_SKIP_COMMON_NAME_CHECK
        bool "Skip server certificate CN fieldcheck"
        default n
        help
            This allows you to skip the validation of OTA server certificate CN field.

    config EXAMPLE_SKIP_VERSION_CHECK
        bool "Skip firmware version check"
        default n
        help
            This allows you to skip the firmware version check.

    config EXAMPLE_GPIO_DIAGNOSTIC
        int "Number of the GPIO input for diagnostic"
        range 0 39
        default 4
        help
            Used to demonstrate how a rollback works.
            The selected GPIO will be configured as an input with internal pull-up enabled.
            To trigger a rollback, this GPIO must be pulled low while the message
            `Diagnostics (5 sec)...` which will be on first boot.
            If GPIO is not pulled low then the operable of the app will be confirmed.

    config EXAMPLE_OTA_RECV_TIMEOUT
        int "OTA Receive Timeout"
        default 5000
        help
            Maximum time for reception    
    config EXAMPLE_EXT1_WAKEUP
        bool "Enable wakeup from GPIO"
        default y
            depends on !IDF_TARGET_ESP32C3
                help
                This option enables wake up from deep sleep from GPIO2 and GPIO4. They should be connected to LOW to avoid
                floating pins. When triggering a wake up, connect one or both of the pins to HIGH. Note that floating
                pins may trigger a wake up.
endmenu
```
